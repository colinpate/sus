## CMakeLists.txt
```
cmake_minimum_required(VERSION 3.20.0)

set(COMMON_DIR ${CMAKE_CURRENT_SOURCE_DIR}/../common)
list(APPEND DTS_ROOT ${COMMON_DIR})

find_package(Zephyr REQUIRED HINTS $ENV{ZEPHYR_BASE})
project(sus_board_bringup)

target_include_directories(app PRIVATE
	${COMMON_DIR}/src
	${CMAKE_CURRENT_SOURCE_DIR}/src
)

target_sources(app PRIVATE
	${COMMON_DIR}/src/as5600.c
	${COMMON_DIR}/src/battery.c
	${COMMON_DIR}/src/board_power.c
	${COMMON_DIR}/src/sensor_reader.c
	src/flash_smoke_test.c
	src/main.c
)
```

## prj.conf
```kconfig
CONFIG_GPIO=y
CONFIG_ADC=y
CONFIG_I2C=y
CONFIG_SPI=y
CONFIG_FLASH=y
CONFIG_SPI_NOR=y
CONFIG_SPI_NOR_SFDP_RUNTIME=y
CONFIG_FLASH_JESD216_API=y
CONFIG_SPI_NOR_FLASH_LAYOUT_PAGE_SIZE=4096
CONFIG_SENSOR=y

CONFIG_LSM6DSO=y
CONFIG_LSM6DSO_ENABLE_TEMP=y
CONFIG_LSM6DSO_TRIGGER_NONE=y

CONFIG_MMC56X3=y

CONFIG_LIS3MDL=y
CONFIG_LIS3MDL_ODR="155"
CONFIG_LIS3MDL_FS=8
CONFIG_LIS3MDL_TRIGGER_NONE=y

CONFIG_PRINTK=y
CONFIG_SERIAL=y
CONFIG_CONSOLE=y
CONFIG_UART_CONSOLE=y
CONFIG_MAIN_STACK_SIZE=2048
```

## app.overlay
```dts
#include "../common/sus_board.dtsi"
```

## dts/bindings/sus-board.yaml
```yaml
description: Board-level controls for the SUS sensor firmware

compatible: "zephyr,user"

properties:
  vperiph-en-gpios:
    type: phandle-array
    required: true
    description: GPIO that enables the switched peripheral rail.
```

## src/main.c
```c
#include <stdint.h>

#include <zephyr/kernel.h>
#include <zephyr/sys/printk.h>

#include "as5600.h"
#include "battery.h"
#include "board_power.h"
#include "flash_smoke_test.h"
#include "sensor_reader.h"

#define SAMPLE_INTERVAL K_MSEC(200)

static void print_vector(const char *name, const int16_t value[3],
			 const char *unit)
{
	printk("%s=(%d, %d, %d) %s", name, value[0], value[1], value[2],
	       unit);
}

static void print_imu(const char *name, enum sus_sensor sensor,
		      const struct sus_sensor_sample *sample)
{
	if ((sample->valid & sensor) == 0U) {
		printk("%s=ERR", name);
		return;
	}

	const struct sus_imu_sample *imu =
		(sensor == SUS_SENSOR_IMU1) ? &sample->imu1 : &sample->imu2;
	int32_t temperature_magnitude =
		imu->temp_deci_c < 0 ? -imu->temp_deci_c : imu->temp_deci_c;

	printk("%s: ", name);
	print_vector("accel", imu->accel_mg, "mg");
	printk(" ");
	print_vector("gyro", imu->gyro_dps10, "0.1dps");
	printk(" temp=%s%d.%d C", imu->temp_deci_c < 0 ? "-" : "",
	       temperature_magnitude / 10, temperature_magnitude % 10);
}

static void print_magnetometer(const char *name, enum sus_sensor sensor,
			       const int16_t field_mg[3],
			       const struct sus_sensor_sample *sample)
{
	if ((sample->valid & sensor) == 0U) {
		printk("%s=ERR", name);
		return;
	}

	printk("%s: ", name);
	print_vector("field", field_mg, "mG");
}

static void print_angle(const struct sus_as5600 *sensor)
{
	uint16_t angle;

	if (sus_as5600_read(sensor, &angle) != 0) {
		printk("AS5600=ERR");
		return;
	}

	printk("AS5600: angle=%u raw", angle);
}

static void print_battery(void)
{
	int32_t battery_mv;

	if (sus_battery_read_mv(&battery_mv) != 0) {
		printk("Battery=ERR");
		return;
	}

	printk("Battery=%d mV", battery_mv);
}

int main(void)
{
	struct sus_as5600 angle_sensor;
	struct flash_smoke_test_result flash_result;
	struct sus_sensor_reader reader;
	int angle_err;
	int battery_err;
	int flash_err;

	printk("\nSUS sensor console starting\n");
	battery_err = sus_battery_init();
	if (battery_err != 0) {
		printk("Battery monitor initialization failed, err=%d\n",
		       battery_err);
	}

	if (!board_peripheral_power_is_ready()) {
		printk("Peripheral power rail failed to initialize\n");
		return 0;
	}

	flash_err = flash_smoke_test_run(&flash_result);
	if (flash_err != 0) {
		printk("Flash: SPI transaction failed, err=%d (FAIL)\n",
		       flash_err);
	} else {
		printk("Flash: JEDEC ID=%02x %02x %02x (%s)\n",
		       flash_result.jedec_id[0], flash_result.jedec_id[1],
		       flash_result.jedec_id[2],
		       flash_result.matches_expected_id ? "PASS" : "FAIL");
	}

	sus_sensor_reader_init(&reader);
	angle_err = sus_as5600_init(&angle_sensor);
	printk("Detected sensors: IMU1=%s IMU2=%s MMC5603=%s LIS3MDL=%s "
	       "AS5600=%s\n",
	       (reader.available & SUS_SENSOR_IMU1) != 0U ? "yes" : "no",
	       (reader.available & SUS_SENSOR_IMU2) != 0U ? "yes" : "no",
	       (reader.available & SUS_SENSOR_MMC5603) != 0U ? "yes" : "no",
	       (reader.available & SUS_SENSOR_LIS3MDL) != 0U ? "yes" : "no",
	       angle_err == 0 ? "yes" : "no");
	if (angle_err != 0) {
		printk("AS5600 initialization failed, err=%d\n", angle_err);
	}
	printk("Reading sensors every 200 ms\n");

	while (true) {
		struct sus_sensor_sample sample;

		sus_sensor_reader_read(&reader, &sample);

		printk("[%u ms] ", sample.timestamp_ms);
		print_imu("IMU1", SUS_SENSOR_IMU1, &sample);
		printk(" | ");
		print_imu("IMU2", SUS_SENSOR_IMU2, &sample);
		printk("\n           ");
		print_magnetometer("MMC5603", SUS_SENSOR_MMC5603,
				   sample.mmc5603_mg, &sample);
		printk(" | ");
		print_magnetometer("LIS3MDL", SUS_SENSOR_LIS3MDL,
				   sample.lis3mdl_mg, &sample);
		printk(" | ");
		print_angle(&angle_sensor);
		printk(" | ");
		print_battery();
		printk("\n");

		k_sleep(SAMPLE_INTERVAL);
	}

	return 0;
}
```

## src/board_power.c
```c
#include "board_power.h"

#include <zephyr/devicetree.h>
#include <zephyr/drivers/gpio.h>
#include <zephyr/init.h>
#include <zephyr/kernel.h>

#define SUS_BOARD_NODE DT_NODELABEL(sus_board)

static const struct gpio_dt_spec peripheral_enable =
	GPIO_DT_SPEC_GET(SUS_BOARD_NODE, vperiph_en_gpios);
static bool peripheral_power_ready;

static int board_peripheral_power_init(void)
{
	int err;

	if (!gpio_is_ready_dt(&peripheral_enable)) {
		return 0;
	}

	err = gpio_pin_configure_dt(&peripheral_enable, GPIO_OUTPUT_ACTIVE);
	if (err != 0) {
		return 0;
	}

	/* Allow the switched sensor rail to settle before sensor driver init. */
	k_busy_wait(5000);
	peripheral_power_ready = true;
	return 0;
}

SYS_INIT(board_peripheral_power_init, POST_KERNEL, 0);

bool board_peripheral_power_is_ready(void)
{
	return peripheral_power_ready;
}
```

## src/board_power.h
```c
#ifndef SUS_BOARD_POWER_H_
#define SUS_BOARD_POWER_H_

#include <stdbool.h>

bool board_peripheral_power_is_ready(void);

#endif /* SUS_BOARD_POWER_H_ */
```

## src/flash.c
```c
#include "flash.h"

#include <limits.h>
#include <stddef.h>
#include <stdint.h>
#include <string.h>

#define FLASH_CRC_INITIAL UINT32_MAX

_Static_assert(sizeof(struct flash_chunk) == FLASH_LOG_SECTOR_BYTES,
	       "flash_chunk must occupy exactly one flash sector");
_Static_assert(offsetof(struct flash_chunk, payload) == 14U,
	       "flash_chunk header layout changed");
_Static_assert(offsetof(struct flash_chunk, crc) ==
		       FLASH_LOG_SECTOR_BYTES - sizeof(uint32_t),
	       "flash_chunk CRC must be the final word in the sector");

static bool flash_log_has_storage(const struct flash_storage_ops *storage)
{
	return storage != NULL && storage->read_sector != NULL &&
	       storage->write_sector != NULL && storage->erase_sector != NULL;
}

static bool
flash_log_has_transport(const struct flash_transport_ops *transport)
{
	return transport != NULL && transport->send_log_start != NULL &&
	       transport->send_chunk != NULL && transport->send_log_end != NULL;
}

static uint32_t flash_crc32_update(uint32_t state, const void *data,
				   size_t length)
{
	const uint8_t *bytes = data;

	for (size_t i = 0; i < length; i++) {
		state ^= bytes[i];
		for (uint8_t bit = 0; bit < 8U; bit++) {
			uint32_t mask = 0U - (state & 1U);

			state = (state >> 1U) ^
				(UINT32_C(0xedb88320) & mask);
		}
	}

	return state;
}

static uint32_t flash_crc32_finish(uint32_t state)
{
	return ~state;
}

static void flash_store_u32_le(uint8_t output[4], uint32_t value)
{
	output[0] = (uint8_t)value;
	output[1] = (uint8_t)(value >> 8U);
	output[2] = (uint8_t)(value >> 16U);
	output[3] = (uint8_t)(value >> 24U);
}

static uint32_t flash_load_u32_le(const uint8_t input[4])
{
	return (uint32_t)input[0] | ((uint32_t)input[1] << 8U) |
	       ((uint32_t)input[2] << 16U) |
	       ((uint32_t)input[3] << 24U);
}

static bool flash_chunk_header_is_valid(const struct flash_chunk *chunk)
{
	if (chunk->magic == FLASH_LOG_DATA_MAGIC) {
		return chunk->payload_length <= FLASH_LOG_PAYLOAD_BYTES;
	}
	if (chunk->magic == FLASH_LOG_COMMIT_MAGIC) {
		return chunk->payload_length ==
		       FLASH_LOG_COMMIT_PAYLOAD_BYTES;
	}
	return false;
}

void flash_chunk_finalize(struct flash_chunk *chunk)
{
	size_t crc_length =
		offsetof(struct flash_chunk, payload) + chunk->payload_length;
	uint32_t state =
		flash_crc32_update(FLASH_CRC_INITIAL, chunk, crc_length);

	chunk->crc = flash_crc32_finish(state);
}

bool flash_chunk_is_valid(const struct flash_chunk *chunk)
{
	size_t crc_length;
	uint32_t state;

	if (chunk == NULL || !flash_chunk_header_is_valid(chunk)) {
		return false;
	}

	crc_length =
		offsetof(struct flash_chunk, payload) + chunk->payload_length;
	state = flash_crc32_update(FLASH_CRC_INITIAL, chunk, crc_length);
	return chunk->crc == flash_crc32_finish(state);
}

static bool flash_chunk_is_older(const struct flash_chunk *candidate,
				 uint32_t oldest_log_id,
				 uint32_t oldest_sequence)
{
	return candidate->log_id < oldest_log_id ||
	       (candidate->log_id == oldest_log_id &&
		candidate->sequence < oldest_sequence);
}

static bool flash_chunk_is_newer(const struct flash_chunk *candidate,
				 uint32_t newest_log_id,
				 uint32_t newest_sequence)
{
	return candidate->log_id > newest_log_id ||
	       (candidate->log_id == newest_log_id &&
		candidate->sequence > newest_sequence);
}

static enum flash_log_result
flash_log_read_sector(struct flash_log *log, uint32_t sector,
		      enum flash_sector_state *state)
{
	if (log->storage->read_sector(log->storage_context, sector,
				      log->scratch, state) != 0) {
		return FLASH_LOG_IO_ERROR;
	}

	return FLASH_LOG_OK;
}

static enum flash_log_result
flash_log_erase_range(struct flash_log *log, uint32_t start, uint32_t end)
{
	uint32_t cursor = start;
	uint32_t traversed = 0;

	while (cursor != end) {
		if (log->storage->erase_sector(log->storage_context,
					      cursor) != 0) {
			return FLASH_LOG_IO_ERROR;
		}

		traversed++;
		if (traversed >= log->sector_count) {
			return FLASH_LOG_CORRUPT;
		}
		cursor = flash_log_next_sector(log, cursor);
	}

	return FLASH_LOG_OK;
}

static enum flash_log_result
flash_log_validate_journal(struct flash_log *log,
			   uint32_t valid_sector_count)
{
	uint32_t cursor = log->read_sector;
	uint32_t traversed = 0;
	uint32_t current_log_id = 0;
	uint32_t expected_sequence = 0;
	uint32_t log_crc_state = FLASH_CRC_INITIAL;
	uint32_t current_log_start = cursor;
	bool first_log = true;
	bool committed = false;

	while (cursor != log->write_sector) {
		enum flash_sector_state state;
		enum flash_log_result result =
			flash_log_read_sector(log, cursor, &state);

		if (result != FLASH_LOG_OK) {
			return result;
		}
		if (state != FLASH_SECTOR_VALID ||
		    !flash_chunk_is_valid(log->scratch)) {
			return FLASH_LOG_CORRUPT;
		}

		if (first_log || log->scratch->log_id != current_log_id) {
			if (!first_log && !committed) {
				return FLASH_LOG_CORRUPT;
			}
			current_log_id = log->scratch->log_id;
			current_log_start = cursor;
			expected_sequence = 0;
			log_crc_state = FLASH_CRC_INITIAL;
			committed = false;
			first_log = false;
		}

		if (log->scratch->magic == FLASH_LOG_DATA_MAGIC) {
			if (committed ||
			    log->scratch->sequence != expected_sequence) {
				return FLASH_LOG_CORRUPT;
			}
			log_crc_state = flash_crc32_update(
				log_crc_state, log->scratch->payload,
				log->scratch->payload_length);
			expected_sequence++;
		} else {
			uint32_t committed_crc =
				flash_load_u32_le(log->scratch->payload);

			if (committed ||
			    log->scratch->sequence != expected_sequence ||
			    committed_crc !=
				    flash_crc32_finish(log_crc_state)) {
				return FLASH_LOG_CORRUPT;
			}
			committed = true;
		}

		traversed++;
		if (traversed >= log->sector_count) {
			return FLASH_LOG_CORRUPT;
		}
		cursor = flash_log_next_sector(log, cursor);
	}

	if (traversed != valid_sector_count) {
		return FLASH_LOG_CORRUPT;
	}
	if (!committed) {
		log->incomplete_start_sector = current_log_start;
		log->incomplete_log_id = current_log_id;
	}
	return committed ? FLASH_LOG_OK : FLASH_LOG_INCOMPLETE;
}

static enum flash_log_result
flash_log_locate_committed_log(struct flash_log *log, uint32_t *end_sector,
			       uint32_t *log_id, uint32_t *log_crc)
{
	uint32_t cursor = log->read_sector;
	uint32_t expected_sequence = 0;
	uint32_t crc_state = FLASH_CRC_INITIAL;

	while (cursor != log->write_sector) {
		enum flash_sector_state state;
		enum flash_log_result result =
			flash_log_read_sector(log, cursor, &state);

		if (result != FLASH_LOG_OK) {
			return result;
		}
		if (state != FLASH_SECTOR_VALID ||
		    !flash_chunk_is_valid(log->scratch)) {
			return FLASH_LOG_CORRUPT;
		}

		if (expected_sequence == 0U) {
			*log_id = log->scratch->log_id;
		}
		if (log->scratch->log_id != *log_id) {
			return FLASH_LOG_INCOMPLETE;
		}

		if (log->scratch->magic == FLASH_LOG_DATA_MAGIC) {
			if (log->scratch->sequence != expected_sequence) {
				return FLASH_LOG_CORRUPT;
			}
			crc_state = flash_crc32_update(
				crc_state, log->scratch->payload,
				log->scratch->payload_length);
			expected_sequence++;
			cursor = flash_log_next_sector(log, cursor);
			continue;
		}

		if (log->scratch->sequence != expected_sequence ||
		    flash_load_u32_le(log->scratch->payload) !=
			    flash_crc32_finish(crc_state)) {
			return FLASH_LOG_CORRUPT;
		}

		*log_crc = flash_crc32_finish(crc_state);
		*end_sector = flash_log_next_sector(log, cursor);
		return FLASH_LOG_OK;
	}

	return FLASH_LOG_INCOMPLETE;
}

enum flash_log_result flash_log_init(struct flash_log *log,
				     uint32_t sector_count,
				     struct flash_chunk *scratch,
				     const struct flash_storage_ops *storage,
				     void *storage_context,
				     const struct flash_transport_ops *transport,
				     void *transport_context)
{
	if (log == NULL || scratch == NULL || sector_count < 3U ||
	    !flash_log_has_storage(storage)) {
		return FLASH_LOG_INVALID_ARGUMENT;
	}

	memset(log, 0, sizeof(*log));
	log->sector_count = sector_count;
	log->scratch = scratch;
	log->storage = storage;
	log->storage_context = storage_context;
	log->transport = transport;
	log->transport_context = transport_context;
	log->active_crc_state = FLASH_CRC_INITIAL;

	return FLASH_LOG_OK;
}

uint32_t flash_log_next_sector(const struct flash_log *log, uint32_t sector)
{
	return (sector + 1U) % log->sector_count;
}

bool flash_log_is_empty(const struct flash_log *log)
{
	return log->read_sector == log->write_sector;
}

bool flash_log_is_full(const struct flash_log *log)
{
	return flash_log_next_sector(log, log->write_sector) ==
	       log->read_sector;
}

bool flash_log_can_append(const struct flash_log *log)
{
	uint32_t after_data =
		flash_log_next_sector(log, log->write_sector);

	return flash_log_next_sector(log, after_data) != log->read_sector;
}

enum flash_log_result flash_log_scan(struct flash_log *log)
{
	uint32_t oldest_log_id = UINT32_MAX;
	uint32_t oldest_sequence = UINT32_MAX;
	uint32_t newest_log_id = 0;
	uint32_t newest_sequence = 0;
	uint32_t valid_sector_count = 0;
	uint32_t dirty_sector_count = 0;
	uint32_t dirty_sector = 0;

	if (log == NULL || log->scratch == NULL ||
	    !flash_log_has_storage(log->storage)) {
		return FLASH_LOG_INVALID_ARGUMENT;
	}

	log->read_sector = 0;
	log->write_sector = 0;
	log->next_log_id = 0;
	log->write_active = false;
	log->tail_incomplete = false;

	for (uint32_t sector = 0; sector < log->sector_count; sector++) {
		enum flash_sector_state state;
		enum flash_log_result result =
			flash_log_read_sector(log, sector, &state);

		if (result != FLASH_LOG_OK) {
			return result;
		}
		if (state == FLASH_SECTOR_DIRTY) {
			dirty_sector = sector;
			dirty_sector_count++;
			continue;
		}
		if (state == FLASH_SECTOR_ERASED) {
			continue;
		}
		if (!flash_chunk_is_valid(log->scratch)) {
			return FLASH_LOG_CORRUPT;
		}

		if (valid_sector_count == 0U ||
		    flash_chunk_is_older(log->scratch, oldest_log_id,
					 oldest_sequence)) {
			oldest_log_id = log->scratch->log_id;
			oldest_sequence = log->scratch->sequence;
			log->read_sector = sector;
		}
		if (valid_sector_count == 0U ||
		    flash_chunk_is_newer(log->scratch, newest_log_id,
					 newest_sequence)) {
			newest_log_id = log->scratch->log_id;
			newest_sequence = log->scratch->sequence;
			log->write_sector = flash_log_next_sector(log, sector);
		}
		valid_sector_count++;
	}

	if (valid_sector_count >= log->sector_count) {
		return FLASH_LOG_CORRUPT;
	}
	if (dirty_sector_count != 0U) {
		if (dirty_sector_count != 1U ||
		    dirty_sector != log->write_sector) {
			return FLASH_LOG_CORRUPT;
		}
		if (log->storage->erase_sector(log->storage_context,
					       dirty_sector) != 0) {
			return FLASH_LOG_IO_ERROR;
		}
	}
	if (valid_sector_count == 0U) {
		return FLASH_LOG_OK;
	}

	log->next_log_id = newest_log_id + 1U;
	enum flash_log_result result =
		flash_log_validate_journal(log, valid_sector_count);

	if (result == FLASH_LOG_INCOMPLETE) {
		log->tail_incomplete = true;
	}
	return result;
}

enum flash_log_result flash_log_begin(struct flash_log *log,
				      uint32_t *log_id)
{
	if (log == NULL || !flash_log_has_storage(log->storage)) {
		return FLASH_LOG_INVALID_ARGUMENT;
	}
	if (log->write_active) {
		return FLASH_LOG_BAD_STATE;
	}
	if (log->tail_incomplete) {
		return FLASH_LOG_INCOMPLETE;
	}
	if (flash_log_is_full(log)) {
		return FLASH_LOG_FULL;
	}

	log->write_active = true;
	log->active_log_id = log->next_log_id++;
	log->active_sequence = 0;
	log->active_start_sector = log->write_sector;
	log->active_crc_state = FLASH_CRC_INITIAL;
	if (log_id != NULL) {
		*log_id = log->active_log_id;
	}

	return FLASH_LOG_OK;
}

enum flash_log_result flash_log_append(struct flash_log *log,
				       const void *payload,
				       size_t payload_length)
{
	if (log == NULL || payload == NULL ||
	    payload_length > FLASH_LOG_PAYLOAD_BYTES) {
		return FLASH_LOG_INVALID_ARGUMENT;
	}
	if (!log->write_active) {
		return FLASH_LOG_BAD_STATE;
	}
	if (!flash_log_can_append(log)) {
		return FLASH_LOG_FULL;
	}
	if (log->active_sequence == UINT32_MAX) {
		return FLASH_LOG_FULL;
	}

	memset(log->scratch, 0xff, sizeof(*log->scratch));
	log->scratch->magic = FLASH_LOG_DATA_MAGIC;
	log->scratch->log_id = log->active_log_id;
	log->scratch->sequence = log->active_sequence;
	log->scratch->payload_length = (uint16_t)payload_length;
	memcpy(log->scratch->payload, payload, payload_length);
	flash_chunk_finalize(log->scratch);

	if (log->storage->write_sector(log->storage_context,
				       log->write_sector,
				       log->scratch) != 0) {
		return FLASH_LOG_IO_ERROR;
	}

	log->active_crc_state = flash_crc32_update(
		log->active_crc_state, payload, payload_length);
	log->active_sequence++;
	log->write_sector =
		flash_log_next_sector(log, log->write_sector);
	return FLASH_LOG_OK;
}

enum flash_log_result flash_log_close(struct flash_log *log)
{
	uint32_t log_crc;

	if (log == NULL || !flash_log_has_storage(log->storage)) {
		return FLASH_LOG_INVALID_ARGUMENT;
	}
	if (!log->write_active) {
		return FLASH_LOG_BAD_STATE;
	}
	if (flash_log_is_full(log)) {
		return FLASH_LOG_FULL;
	}

	log_crc = flash_crc32_finish(log->active_crc_state);
	memset(log->scratch, 0xff, sizeof(*log->scratch));
	log->scratch->magic = FLASH_LOG_COMMIT_MAGIC;
	log->scratch->log_id = log->active_log_id;
	log->scratch->sequence = log->active_sequence;
	log->scratch->payload_length = FLASH_LOG_COMMIT_PAYLOAD_BYTES;
	flash_store_u32_le(log->scratch->payload, log_crc);
	flash_chunk_finalize(log->scratch);

	if (log->storage->write_sector(log->storage_context,
				       log->write_sector,
				       log->scratch) != 0) {
		return FLASH_LOG_IO_ERROR;
	}

	log->write_sector =
		flash_log_next_sector(log, log->write_sector);
	log->write_active = false;
	return FLASH_LOG_OK;
}

enum flash_log_result flash_log_abort(struct flash_log *log)
{
	enum flash_log_result result;

	if (log == NULL || !flash_log_has_storage(log->storage)) {
		return FLASH_LOG_INVALID_ARGUMENT;
	}
	if (!log->write_active) {
		return FLASH_LOG_BAD_STATE;
	}

	result = flash_log_erase_range(log, log->active_start_sector,
				       log->write_sector);
	if (result != FLASH_LOG_OK) {
		return result;
	}

	log->write_sector = log->active_start_sector;
	log->next_log_id = log->active_log_id;
	log->write_active = false;
	log->active_crc_state = FLASH_CRC_INITIAL;
	return FLASH_LOG_OK;
}

enum flash_log_result
flash_log_discard_incomplete(struct flash_log *log)
{
	enum flash_log_result result;

	if (log == NULL || !flash_log_has_storage(log->storage)) {
		return FLASH_LOG_INVALID_ARGUMENT;
	}
	if (log->write_active) {
		return FLASH_LOG_BAD_STATE;
	}
	if (!log->tail_incomplete) {
		return FLASH_LOG_BAD_STATE;
	}

	result = flash_log_erase_range(log, log->incomplete_start_sector,
				       log->write_sector);
	if (result != FLASH_LOG_OK) {
		return result;
	}

	log->write_sector = log->incomplete_start_sector;
	log->next_log_id = log->incomplete_log_id;
	log->tail_incomplete = false;
	return FLASH_LOG_OK;
}

enum flash_log_result flash_log_read_one(struct flash_log *log)
{
	uint32_t end_sector;
	uint32_t log_id;
	uint32_t log_crc;
	uint32_t cursor;
	enum flash_log_result result;

	if (log == NULL || log->scratch == NULL ||
	    !flash_log_has_storage(log->storage) ||
	    !flash_log_has_transport(log->transport)) {
		return FLASH_LOG_INVALID_ARGUMENT;
	}
	if (flash_log_is_empty(log)) {
		return FLASH_LOG_EMPTY;
	}

	result = flash_log_locate_committed_log(
		log, &end_sector, &log_id, &log_crc);
	if (result != FLASH_LOG_OK) {
		return result;
	}

	if (log->transport->send_log_start(log->transport_context,
					   log_id) != 0) {
		return FLASH_LOG_TRANSPORT_ERROR;
	}

	cursor = log->read_sector;
	while (cursor != end_sector) {
		enum flash_sector_state state;

		result = flash_log_read_sector(log, cursor, &state);
		if (result != FLASH_LOG_OK) {
			return result;
		}
		if (state != FLASH_SECTOR_VALID ||
		    !flash_chunk_is_valid(log->scratch)) {
			return FLASH_LOG_CORRUPT;
		}
		if (log->scratch->magic == FLASH_LOG_COMMIT_MAGIC) {
			break;
		}
		if (log->transport->send_chunk(log->transport_context,
					       log->scratch) != 0) {
			return FLASH_LOG_TRANSPORT_ERROR;
		}
		cursor = flash_log_next_sector(log, cursor);
	}

	switch (log->transport->send_log_end(log->transport_context,
					     log_id, log_crc)) {
	case FLASH_TRANSPORT_ACK:
		result = flash_log_erase_range(log, log->read_sector,
					       end_sector);
		if (result != FLASH_LOG_OK) {
			return result;
		}
		log->read_sector = end_sector;
		return FLASH_LOG_OK;
	case FLASH_TRANSPORT_DONE:
		return FLASH_LOG_TRANSPORT_DONE;
	case FLASH_TRANSPORT_ERROR:
	default:
		return FLASH_LOG_TRANSPORT_ERROR;
	}
}

enum flash_log_result flash_log_drain(struct flash_log *log,
				      uint8_t max_retries)
{
	uint8_t retries = 0;

	if (log == NULL) {
		return FLASH_LOG_INVALID_ARGUMENT;
	}

	while (!flash_log_is_empty(log)) {
		enum flash_log_result result = flash_log_read_one(log);

		if (result == FLASH_LOG_OK) {
			retries = 0;
			continue;
		}
		if (result != FLASH_LOG_TRANSPORT_ERROR) {
			return result;
		}
		if (retries >= max_retries) {
			return result;
		}
		retries++;
	}

	return FLASH_LOG_OK;
}
```

## src/flash.h
```c
#ifndef SUS_FLASH_H_
#define SUS_FLASH_H_

#include <stdbool.h>
#include <stddef.h>
#include <stdint.h>

#define FLASH_LOG_SECTOR_BYTES 4096U
#define FLASH_LOG_METADATA_BYTES 18U
#define FLASH_LOG_PAYLOAD_BYTES \
	(FLASH_LOG_SECTOR_BYTES - FLASH_LOG_METADATA_BYTES)
#define FLASH_LOG_DATA_MAGIC UINT32_C(0x44535553)
#define FLASH_LOG_COMMIT_MAGIC UINT32_C(0x45535553)
#define FLASH_LOG_COMMIT_PAYLOAD_BYTES 4U

struct flash_chunk {
	uint32_t magic;
	uint32_t log_id;
	uint32_t sequence;
	uint16_t payload_length;
	uint8_t payload[FLASH_LOG_PAYLOAD_BYTES];
	uint32_t crc;
};

enum flash_sector_state {
	FLASH_SECTOR_VALID,
	FLASH_SECTOR_ERASED,
	FLASH_SECTOR_DIRTY,
};

enum flash_transport_result {
	/* The host durably accepted the exact reported range. */
	FLASH_TRANSPORT_ERASE,
	/* Keep the range and send it again. */
	FLASH_TRANSPORT_RETRY,
	/* Stop sending and keep the range. */
	FLASH_TRANSPORT_DONE,
};

enum flash_log_result {
	FLASH_LOG_OK,
	FLASH_LOG_EMPTY,
	FLASH_LOG_FULL,
	FLASH_LOG_CORRUPT,
	FLASH_LOG_IO_ERROR,
	FLASH_LOG_TRANSPORT_ERROR,
	FLASH_LOG_TRANSPORT_DONE,
	FLASH_LOG_BAD_STATE,
	FLASH_LOG_INVALID_ARGUMENT,
};

struct flash_transfer_summary {
	uint32_t log_id;
	uint32_t start_sector;
	/* Half-open range: end_sector is not part of the transfer. */
	uint32_t end_sector;
	uint32_t sector_count;
	/* CRC-32 over all raw 4 KiB sectors in transfer order. */
	uint32_t raw_crc;
};

struct flash_storage_ops {
	int (*read_sector)(void *context, uint32_t sector,
			   struct flash_chunk *chunk,
			   enum flash_sector_state *state);
	int (*write_sector)(void *context, uint32_t sector,
			    const struct flash_chunk *chunk);
	int (*erase_sector)(void *context, uint32_t sector);
};

struct flash_transport_ops {
	int (*begin)(void *context, uint32_t log_id,
		     uint32_t start_sector);
	int (*send_sector)(void *context, uint32_t sector,
			   const struct flash_chunk *raw_sector);
	enum flash_transport_result
		(*finish)(void *context,
			  const struct flash_transfer_summary *summary);
};

struct flash_log {
	uint32_t read_sector;
	uint32_t write_sector;
	uint32_t read_log_id;
	uint32_t next_log_id;
	uint32_t sector_count;
	struct flash_chunk *scratch;
	const struct flash_storage_ops *storage;
	void *storage_context;
	const struct flash_transport_ops *transport;
	void *transport_context;

	bool write_active;
	uint32_t active_log_id;
	uint32_t active_sequence;
	uint32_t active_start_sector;
	uint32_t active_crc_state;
};

enum flash_log_result flash_log_init(struct flash_log *log,
				     uint32_t sector_count,
				     struct flash_chunk *scratch,
				     const struct flash_storage_ops *storage,
				     void *storage_context,
				     const struct flash_transport_ops *transport,
				     void *transport_context);

uint32_t flash_log_next_sector(const struct flash_log *log, uint32_t sector);
bool flash_log_is_empty(const struct flash_log *log);
bool flash_log_is_full(const struct flash_log *log);
bool flash_log_can_append(const struct flash_log *log);

void flash_chunk_finalize(struct flash_chunk *chunk);
bool flash_chunk_is_valid(const struct flash_chunk *chunk);

enum flash_log_result flash_log_scan(struct flash_log *log);
enum flash_log_result flash_log_begin(struct flash_log *log,
				      uint32_t *log_id);
enum flash_log_result flash_log_append(struct flash_log *log,
				       const void *payload,
				       size_t payload_length);
enum flash_log_result flash_log_close(struct flash_log *log);
enum flash_log_result flash_log_abort(struct flash_log *log);
enum flash_log_result flash_log_read_one(struct flash_log *log);
enum flash_log_result flash_log_drain(struct flash_log *log,
				      uint8_t max_retries);

#endif /* SUS_FLASH_H_ */
```

## src/flash_smoke_test.c
```c
#include "flash_smoke_test.h"

#include <errno.h>
#include <string.h>

#include <zephyr/device.h>
#include <zephyr/devicetree.h>
#include <zephyr/drivers/flash.h>

#define FLASH_EXPECTED_MANUFACTURER 0xc2
#define FLASH_EXPECTED_MEMORY_TYPE 0x20
#define FLASH_EXPECTED_DENSITY 0x19

static const struct device *const flash =
	DEVICE_DT_GET(DT_NODELABEL(mx25l25645g));

int flash_smoke_test_run(struct flash_smoke_test_result *result)
{
	int err;

	if (result == NULL) {
		return -EINVAL;
	}
	memset(result, 0, sizeof(*result));

	if (!device_is_ready(flash)) {
		return -ENODEV;
	}

	err = flash_read_jedec_id(flash, result->jedec_id);
	if (err != 0) {
		return err;
	}

	result->matches_expected_id =
		result->jedec_id[0] == FLASH_EXPECTED_MANUFACTURER &&
		result->jedec_id[1] == FLASH_EXPECTED_MEMORY_TYPE &&
		result->jedec_id[2] == FLASH_EXPECTED_DENSITY;

	return 0;
}
```

## src/flash_smoke_test.h
```c
#ifndef SUS_FLASH_SMOKE_TEST_H_
#define SUS_FLASH_SMOKE_TEST_H_

#include <stdbool.h>
#include <stdint.h>

struct flash_smoke_test_result {
	uint8_t jedec_id[3];
	bool matches_expected_id;
};

/*
 * Wake the external flash and read its JEDEC manufacturer/device ID.
 * This test is read-only and does not erase or program the chip.
 */
int flash_smoke_test_run(struct flash_smoke_test_result *result);

#endif /* SUS_FLASH_SMOKE_TEST_H_ */
```

## src/flash_zephyr.c
```c
#include "flash_zephyr.h"

#include <errno.h>
#include <stdbool.h>
#include <stddef.h>
#include <stdint.h>

#include <zephyr/device.h>
#include <zephyr/devicetree.h>
#include <zephyr/drivers/flash.h>
#include <zephyr/sys/util.h>

#define MX25L25645G_NODE DT_NODELABEL(mx25l25645g)
#define MX25L25645G_BYTES (DT_PROP(MX25L25645G_NODE, size) / 8U)
#define MX25L25645G_SECTORS \
	(MX25L25645G_BYTES / FLASH_LOG_SECTOR_BYTES)

BUILD_ASSERT(DT_NODE_HAS_STATUS(MX25L25645G_NODE, okay),
	     "mx25l25645g devicetree node must be enabled");
BUILD_ASSERT((DT_PROP(MX25L25645G_NODE, size) % 8U) == 0U,
	     "SPI NOR size must contain a whole number of bytes");
BUILD_ASSERT((MX25L25645G_BYTES % FLASH_LOG_SECTOR_BYTES) == 0U,
	     "SPI NOR size must be a multiple of the log sector size");

static bool flash_zephyr_sector_is_erased(const struct flash_chunk *chunk)
{
	const uint8_t *bytes = (const uint8_t *)chunk;

	for (size_t i = 0; i < sizeof(*chunk); i++) {
		if (bytes[i] != UINT8_MAX) {
			return false;
		}
	}
	return true;
}

static bool flash_zephyr_sector_in_range(
	const struct flash_zephyr_storage *storage, uint32_t sector)
{
	return storage != NULL && storage->device != NULL &&
	       sector < storage->sector_count;
}

static off_t flash_zephyr_sector_offset(
	const struct flash_zephyr_storage *storage, uint32_t sector)
{
	return (off_t)storage->base_offset +
	       (off_t)sector * FLASH_LOG_SECTOR_BYTES;
}

static int flash_zephyr_read_sector(void *context, uint32_t sector,
				    struct flash_chunk *chunk,
				    enum flash_sector_state *state)
{
	struct flash_zephyr_storage *storage = context;
	int err;

	if (!flash_zephyr_sector_in_range(storage, sector) ||
	    chunk == NULL || state == NULL) {
		return -EINVAL;
	}

	err = flash_read(storage->device,
			 flash_zephyr_sector_offset(storage, sector),
			 chunk, sizeof(*chunk));
	if (err != 0) {
		return err;
	}

	if (flash_zephyr_sector_is_erased(chunk)) {
		*state = FLASH_SECTOR_ERASED;
	} else if (flash_chunk_is_valid(chunk)) {
		*state = FLASH_SECTOR_VALID;
	} else {
		*state = FLASH_SECTOR_DIRTY;
	}
	return 0;
}

static int flash_zephyr_write_sector(void *context, uint32_t sector,
				     const struct flash_chunk *chunk)
{
	struct flash_zephyr_storage *storage = context;

	if (!flash_zephyr_sector_in_range(storage, sector) ||
	    chunk == NULL || !flash_chunk_is_valid(chunk)) {
		return -EINVAL;
	}

	return flash_write(storage->device,
			   flash_zephyr_sector_offset(storage, sector),
			   chunk, sizeof(*chunk));
}

static int flash_zephyr_erase_sector(void *context, uint32_t sector)
{
	struct flash_zephyr_storage *storage = context;

	if (!flash_zephyr_sector_in_range(storage, sector)) {
		return -EINVAL;
	}

	return flash_erase(storage->device,
			   flash_zephyr_sector_offset(storage, sector),
			   FLASH_LOG_SECTOR_BYTES);
}

const struct flash_storage_ops flash_zephyr_storage_ops = {
	.read_sector = flash_zephyr_read_sector,
	.write_sector = flash_zephyr_write_sector,
	.erase_sector = flash_zephyr_erase_sector,
};

int flash_zephyr_storage_init(struct flash_zephyr_storage *storage,
			      const struct device *device,
			      uint32_t base_offset,
			      uint32_t sector_count)
{
	uint64_t end_offset;

	if (storage == NULL || device == NULL || sector_count < 3U ||
	    !device_is_ready(device) ||
	    (base_offset % FLASH_LOG_SECTOR_BYTES) != 0U) {
		return -EINVAL;
	}

	end_offset = (uint64_t)base_offset +
		     (uint64_t)sector_count * FLASH_LOG_SECTOR_BYTES;
	if (end_offset > MX25L25645G_BYTES) {
		return -ERANGE;
	}

	storage->device = device;
	storage->base_offset = base_offset;
	storage->sector_count = sector_count;
	return 0;
}

int flash_zephyr_storage_init_default(struct flash_zephyr_storage *storage)
{
	return flash_zephyr_storage_init(
		storage, DEVICE_DT_GET(MX25L25645G_NODE), 0U,
		MX25L25645G_SECTORS);
}
```

## src/sensor_reader.h
```c
#ifndef SUS_SENSOR_READER_H_
#define SUS_SENSOR_READER_H_

#include <stdint.h>

enum sus_sensor {
	SUS_SENSOR_IMU1 = 1U << 0,
	SUS_SENSOR_IMU2 = 1U << 1,
	SUS_SENSOR_MMC5603 = 1U << 2,
	SUS_SENSOR_LIS3MDL = 1U << 3,
};

struct sus_sensor_reader {
	uint32_t available;
	uint32_t sequence;
};

struct sus_imu_sample {
	int16_t accel_mg[3];
	int16_t gyro_dps10[3];
	int32_t temp_deci_c;
};

struct sus_sensor_sample {
	uint32_t timestamp_ms;
	uint32_t sequence;
	uint32_t valid;
	struct sus_imu_sample imu1;
	struct sus_imu_sample imu2;
	int16_t mmc5603_mg[3];
	int16_t lis3mdl_mg[3];
};

void sus_sensor_reader_init(struct sus_sensor_reader *reader);
void sus_sensor_reader_read(struct sus_sensor_reader *reader,
			    struct sus_sensor_sample *sample);

#endif /* SUS_SENSOR_READER_H_ */
```
